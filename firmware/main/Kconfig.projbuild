## firmware/main/Kconfig.projbuild
```kconfig
menu "SS-SP Lite optional modules (fully-loaded configuration)"

    comment "Hardware ref: 01_SS-SP_LITE_HARDWARE_REFERENCE.md §3.15"

    choice SS_LITE_WIRELESS_HEADER
        prompt "Wireless-header module (exactly one)"
        default SS_LITE_MOD_SX1262
        help
            The CrowPanel Advance wireless header carries one long-range
            radio module: the stock SX1262 LoRa (Meshtastic edition) or the
            Elecrow HaLow module. Both use the same header SPI + control
            pins and the GPIO 45 mic/radio mux.

        config SS_LITE_MOD_SX1262
            bool "SX1262 LoRa (stock Meshtastic edition)"

        config SS_LITE_MOD_HALOW
            bool "Wi-Fi HaLow module (sub-GHz antenna)"
    endchoice

    config SS_LITE_MOD_GNSS_BN880
        bool "BN-880 GNSS + HMC5883L compass (UART1 18/17 + I2C0 @0x1E)"
        default y

    choice SS_LITE_COPROC
        prompt "Mesh coprocessor on UART2 (44/43)"
        default SS_LITE_MOD_COPROC_C6

        config SS_LITE_MOD_COPROC_NONE
            bool "None"

        config SS_LITE_MOD_COPROC_C6
            bool "ESP32-C6 (Wi-Fi 6 + BLE 5.3 + 802.15.4)"

        config SS_LITE_MOD_COPROC_H2
            bool "ESP32-H2 (Thread/Zigbee/802.15.4 + BLE)"
    endchoice

    config SS_LITE_MOD_IMU
        bool "6-axis IMU on I2C Grove header (@0x68, tilt-compensated compass)"
        default y

endmenu

menu "SS-SP runtime diagnostics"

    config SS_MEMWATCH_PERIOD_MS
        int "Memory-watch sample period (ms)"
        default 10000
        range 1000 600000
        help
            Interval between ss_memwatch samples (S-02-011): heap high-water /
            fragmentation stats, per-task stack watermarks, and IDLE0/1
            CPU-load deltas are logged once per period. A shorter period
            raises log volume and the sampling overhead; the default (10 s)
            matches the boot heartbeat cadence in main.cpp.

endmenu

menu "SS-SP recovery (S-02-016)"

    config SS_RECOVERY_BTN_GPIO
        int "Recovery BOOT-button GPIO"
        default 0
        help
            GPIO sampled by the recovery entry-window watcher. GPIO0 is the
            ESP32-S3 BOOT strapping pin and, on Lite, is shared with
            SS_LORA_PIN_CS (board_config.h). The watcher claims it as
            input+pull-up only inside the entry window; radio bring-up
            (EPIC-05) must init LoRa SPI only after the window closes.

    config SS_RECOVERY_HOLD_MS
        int "Continuous BOOT-hold to enter recovery (ms)"
        default 3000
        range 500 10000
        help
            Unbroken press duration that triggers a recovery request. The hold
            must START AFTER reset release (GPIO0 LOW at reset puts the ROM in
            download mode): "press RESET, then hold BOOT for this long".

    config SS_RECOVERY_ENTRY_WINDOW_MS
        int "Recovery button entry window (ms, 0 disables)"
        default 10000
        range 0 60000
        help
            How long after boot the BOOT-button watcher samples for the hold
            gesture. 0 disables the watcher entirely (compile-time no-op). The
            window must close before radio bring-up (EPIC-05) claims GPIO0, or
            the window must be shrunk/disabled here.

endmenu
```

## firmware/sdkconfig.defaults
```kconfig
# SPDX-License-Identifier: Apache-2.0
# SS-SP Lite (ESP32-S3-WROOM-1-N16R8) build defaults.
# See 01_SS-SP_LITE_HARDWARE_REFERENCE.md §4.1.

CONFIG_IDF_TARGET="esp32s3"

# --- Flash: 16 MB, custom A/B OTA partition table ---------------------------
CONFIG_ESPTOOLPY_FLASHSIZE_16MB=y
CONFIG_PARTITION_TABLE_CUSTOM=y
CONFIG_PARTITION_TABLE_CUSTOM_FILENAME="partitions.csv"

# --- PSRAM: 8 MB Octal @ 80 MHz ---------------------------------------------
CONFIG_SPIRAM=y
CONFIG_SPIRAM_MODE_OCT=y
CONFIG_SPIRAM_SPEED_80M=y
CONFIG_SPIRAM_MALLOC_ALWAYSINTERNAL=4096

# --- Console on native USB-Serial-JTAG (frees UART1/UART2 for modules) ------
CONFIG_ESP_CONSOLE_USB_SERIAL_JTAG=y

# --- RTOS / performance ------------------------------------------------------
CONFIG_FREERTOS_HZ=1000
CONFIG_COMPILER_OPTIMIZATION_PERF=y
CONFIG_ESP_MAIN_TASK_STACK_SIZE=8192
# S-02-006: explicit task-stack canary check (overflow -> canary fail -> panic;
# flash-dump post-mortem lands with S-02-008). Kept explicit even though this
# is the IDF default so the RTOS baseline is self-documenting.
CONFIG_FREERTOS_CHECK_STACKOVERFLOW_CANARY=y

# --- S-02-009: task / interrupt watchdog policy -----------------------------
# Task WDT (TWDT): a task that hangs (fails to feed within the deadline) must
# RECOVER via panic -> reboot, not merely emit a warning — a wedged pager is
# useless in the field. Hence PANIC=y (structured flash-dump post-mortem of the
# ensuing panic lands with S-02-008). The idle tasks on both cores are
# subscribed so a runaway task that starves an idle task is also caught.
# App tasks whose loop latency is bounded strictly under the 5 s deadline
# register + feed through the ss_task_wdt_* API (see ss_hal_watchdog.h
# WATCHDOG POLICY — the contract of record since S-03-039).
CONFIG_ESP_TASK_WDT_EN=y
CONFIG_ESP_TASK_WDT_INIT=y
CONFIG_ESP_TASK_WDT_TIMEOUT_S=5
CONFIG_ESP_TASK_WDT_PANIC=y
CONFIG_ESP_TASK_WDT_CHECK_IDLE_TASK_CPU0=y
CONFIG_ESP_TASK_WDT_CHECK_IDLE_TASK_CPU1=y
# Interrupt WDT (IWDT): guards against ISRs / critical sections that disable
# interrupts for too long (protects ISR latency). Kept at the IDF-default
# timeout (~300 ms); only the enable + CPU1 coverage are made explicit here.
CONFIG_ESP_INT_WDT=y
CONFIG_ESP_INT_WDT_CHECK_CPU1=y

# --- S-02-008: panic post-mortem (coredump to flash) ------------------------
# Every panic path (fault, assert, stack canary, TWDT/IWDT expiry) writes an
# ELF core dump to the dedicated `coredump` partition, then reboots. ELF format
# so the record decodes with tools/xtensa-decode-crash.py (espcoredump under
# the hood). CRC32 integrity (SHA256 costs more panic-path stack for no
# security benefit here — the dump is integrity-, not authenticity-checked).
# A dedicated coredump stack is mandatory: a primary panic source IS stack
# overflow, so dumping on the faulting task's stack would corrupt the evidence
# and can wedge the dump writer.
# Dump-content hygiene contract: see firmware/main/ss_panic_guard.h.
CONFIG_ESP_COREDUMP_ENABLE_TO_FLASH=y
CONFIG_ESP_COREDUMP_DATA_FORMAT_ELF=y
CONFIG_ESP_COREDUMP_CHECKSUM_CRC32=y
CONFIG_ESP_COREDUMP_STACK_SIZE=2048
# Security-relevant default pinned EXPLICITLY (ss_panic_guard.h hygiene
# contract): DRAM capture stays OFF so .data/.bss/heap — i.e. every live
# secret — never lands in the dump. Flipping this needs wg-security sign-off.
CONFIG_ESP_COREDUMP_CAPTURE_DRAM=n

# --- S-02-011: runtime resource telemetry (ss_memwatch) ---------------------
# uxTaskGetSystemState (per-task stack watermarks + run-time counters) requires
# the trace facility; per-task/idle CPU-load deltas require run-time stats. The
# ESP-IDF v5.x default run-time-stats clock on esp32s3 is esp_timer (a 64-bit
# monotonic source shared with ss_bootmark); pinned explicitly so the telemetry
# baseline is self-documenting and cannot silently change clock source.
CONFIG_FREERTOS_USE_TRACE_FACILITY=y
CONFIG_FREERTOS_GENERATE_RUN_TIME_STATS=y
CONFIG_FREERTOS_RUN_TIME_STATS_USING_ESP_TIMER=y

# --- Production hardening (enable on release builds; see EPIC-08) -----------
# CONFIG_SECURE_BOOT=y
# CONFIG_SECURE_FLASH_ENC_ENABLED=y
```

## firmware/test/target/sdkconfig.defaults
```kconfig
# SPDX-License-Identifier: Apache-2.0
# On-target Unity test app defaults (S-02-015).
#
# Kept intentionally small: this is a test harness, not the product image, so it
# uses the default single-app partition table (no OTA/coredump layout). Only the
# knobs the runner depends on are pinned here.

# Target the Lite silicon (ESP32-S3); the AC exercises the Lite board.
CONFIG_IDF_TARGET="esp32s3"

# Console on the native USB-Serial-JTAG, matching the Lite firmware
# (firmware/sdkconfig.defaults) so the Unity summary reaches the same port
# pytest-embedded opens on the device.
CONFIG_ESP_CONSOLE_USB_SERIAL_JTAG=y

# 1 kHz tick to match the RTOS baseline (S-02-006); keeps timing-sensitive
# on-target cases consistent with the shipping image.
CONFIG_FREERTOS_HZ=1000
```
